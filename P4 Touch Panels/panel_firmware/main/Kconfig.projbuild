## P4 Touch Panels/panel_firmware/main/Kconfig.projbuild
```kconfig
menu "Screen test 1 UI"

    config SCREEN_TEST_LOADING_MS
        int "Loading screen duration (ms)"
        default 3000
        range 500 60000
        help
            Time to show the startup Lottie and "Starting up" before switching to Home.

endmenu

menu "Screen test 1 — Reolink doorbell (Front Gate)"

    config SCREEN_TEST_REOLINK_HOST
        string "Reolink doorbell IP or hostname (empty = disable preview)"
        default ""
        help
            LAN address of the doorbell, e.g. 192.168.1.50. Enable HTTP/HTTPS in the Reolink app.
            If empty, the Front Gate screen shows a placeholder with no network fetches.

    config SCREEN_TEST_REOLINK_PORT
        int "HTTP(S) port"
        default 80
        range 1 65535

    config SCREEN_TEST_REOLINK_USE_HTTPS
        bool "Use HTTPS (skip cert verification for local devices)"
        default n
        help
            Uses https:// on SCREEN_TEST_REOLINK_PORT (often 443). The doorbell must have HTTPS enabled
            in the Reolink app (network / port settings). Firmware uses CONFIG_ESP_TLS_SKIP_SERVER_CERT_VERIFY
            (set in sdkconfig.defaults) so self-signed camera certs work; for maximum security use HTTP only.

    config SCREEN_TEST_REOLINK_USER
        string "Reolink login username"
        default "admin"

    config SCREEN_TEST_REOLINK_PASSWORD
        string "Reolink login password"
        default ""

    config SCREEN_TEST_REOLINK_CHANNEL
        int "Snap channel index"
        default 0
        range 0 7

endmenu

menu "Screen test 1 — Network / Home Assistant"

    config SCREEN_TEST_WIFI_SSID
        string "WiFi SSID"
        default "dora_the_internet_explorer"
        help
            STA SSID. Leave empty to skip Wi-Fi/MQTT (UI still runs).

    config SCREEN_TEST_WIFI_PASSWORD
        string "WiFi password"
        default "defaced123defaced123"

    config SCREEN_TEST_MQTT_BROKER_URI
        string "MQTT broker URI"
        default "mqtt://192.168.1.52:1883"

    config SCREEN_TEST_MQTT_USER
        string "MQTT username"
        default "mqttdevice"

    config SCREEN_TEST_MQTT_PASSWORD
        string "MQTT password"
        default "hhkf76883hdkjnfJfDS"

    config SCREEN_TEST_HA_DEVICE_NAME
        string "Home Assistant device name (discovery)"
        default "ESP32-P4 Ollie Room"

    config SCREEN_TEST_MQTT_ROOM_STATE_TOPIC
        string "Room mode: shared state MQTT topic (plain text; retained)"
        default "esp_hmi/data/bedroom3/desired_state"
        help
            HA → panel: device subscribes here for current room mode (Normal, Rest Time, Sleep Time).
            Ignored if ROOM_STATE_TOPIC_OVERRIDE is non-empty.

    config SCREEN_TEST_MQTT_ROOM_SET_SUFFIX
        string "Room mode: legacy set suffix (unused unless full set topic override is set)"
        default "ollie_room_desired_state/set"
        help
            Room taps publish JSON to esp_hmi/device/<MAC>/status/button_press by default. If full set topic override is non-empty,
            the same JSON is published to that topic instead. This suffix is only used when building the
            default override-empty set topic path (rarely needed now).

    config SCREEN_TEST_MQTT_ROOM_STATE_TOPIC_OVERRIDE
        string "Room mode: full state topic override (empty = ROOM_STATE_TOPIC)"
        default ""
        help
            If non-empty, subscribe to this exact topic instead of SCREEN_TEST_MQTT_ROOM_STATE_TOPIC.

    config SCREEN_TEST_MQTT_ROOM_SET_TOPIC_OVERRIDE
        string "Room mode: alternate publish topic for room JSON (empty = esp_hmi/device/<MAC>/status/button_press)"
        default ""
        help
            If non-empty, publish room JSON {"button": "..."} to this topic instead of esp_hmi/device/<mac>/status/button_press.

    config SCREEN_TEST_MQTT_CLIMATE_SETPOINT_TOPIC
        string "Climate: retained setpoint topic (°C, plain float text)"
        default "esp_hmi/data/bedroom3/climate/setpoint"

    config SCREEN_TEST_MQTT_CLIMATE_CURRENT_TOPIC
        string "Climate: retained current temp topic (°C, plain float text)"
        default "esp_hmi/data/bedroom3/climate/current"

    config SCREEN_TEST_MQTT_CLIMATE_HEATER_TOPIC
        string "Climate: retained heater on/off topic (plain: true/false, on/off, 1/0)"
        default "esp_hmi/data/bedroom3/climate/heater_on"

    config SCREEN_TEST_MQTT_CLIMATE_CONTROL_TOPIC
        string "Climate: retained HVAC/climate-control topic (HA climate state: heat/off; legacy bool ok)"
        default "esp_hmi/data/bedroom3/climate/control"

    config SCREEN_TEST_MQTT_FRONT_GATE_STATE_TOPIC
        string "Front Gate: retained gate state topic"
        default "esp_hmi/data/front_gate/state"
        help
            HA -> panel Front Gate status. Expected values include Closed, Partially Open, and open.

endmenu

menu "Screen test 1 — OTA (MQTT / HTTPS)"

    config SCREEN_TEST_OTA_ENABLE
        bool "Enable MQTT-triggered HTTPS OTA"
        default y
        help
            Subscribes to esp_hmi/device/<MAC>/<suffix> with JSON {"url":"https://...","version":"..."}.
            Requires two OTA app partitions (see partitions.csv).

    config SCREEN_TEST_OTA_MQTT_CMD_SUFFIX
        string "OTA command topic suffix (after esp_hmi/device/<MAC>/)"
        depends on SCREEN_TEST_OTA_ENABLE
        default "cmd/ota_update"
        help
            Full topic is built as: esp_hmi/device/<12hexlowercase>/<SCREEN_TEST_OTA_MQTT_CMD_SUFFIX>

    config SCREEN_TEST_OTA_HTTP_TIMEOUT_MS
        int "HTTPS OTA download timeout (ms)"
        depends on SCREEN_TEST_OTA_ENABLE
        default 120000
        range 10000 600000

    config SCREEN_TEST_OTA_SKIP_CERT_VERIFY
        bool "Skip HTTPS server certificate verification (OTA only)"
        depends on SCREEN_TEST_OTA_ENABLE
        default n
        help
            INSECURE: use only for LAN / self-signed firmware servers. When n, uses esp_crt_bundle_attach for public HTTPS.

endmenu
```

## P4 Touch Panels/panel_firmware/sdkconfig.defaults
```kconfig
# Waveshare round P4 boards using component waveshare/esp32_p4_wifi6_touch_lcd_4b (4B / 3.4C / 4C family).
# Pick LCD type below to match the physical panel: 800×800 3.4" vs 720×720 4" (Waveshare labels the latter "4C" on the 3.4C product page).
# Wiki: https://www.waveshare.com/wiki/ESP32-P4-WIFI6-Touch-LCD-4B · https://www.waveshare.com/wiki/ESP32-P4-WIFI6-Touch-LCD-3.4C
#
# Wi-Fi is on the C6 via esp_hosted (SDIO) + esp_wifi_remote — do not enable native P4 host Wi-Fi.

# --- Flash / partition / OTA rollback (see partitions.csv) ---
CONFIG_ESPTOOLPY_FLASHSIZE_16MB=y
CONFIG_PARTITION_TABLE_CUSTOM=y
CONFIG_PARTITION_TABLE_CUSTOM_FILENAME="partitions.csv"
CONFIG_PARTITION_TABLE_FILENAME="partitions.csv"
CONFIG_PARTITION_TABLE_OFFSET=0x8000
# App rollback follows bootloader option on IDF 5.4+ (no separate CONFIG_APP_ROLLBACK_ENABLE).
CONFIG_BOOTLOADER_APP_ROLLBACK_ENABLE=y

# --- PSRAM (MIPI-DPI / LVGL buffers use SPIRAM) ---
CONFIG_SPIRAM=y
CONFIG_SPIRAM_MODE_HEX=y
CONFIG_SPIRAM_SPEED_200M=y
CONFIG_SPIRAM_BOOT_INIT=y
CONFIG_SPIRAM_USE_MALLOC=y
CONFIG_SPIRAM_MALLOC_ALWAYSINTERNAL=16384
CONFIG_SPIRAM_MALLOC_RESERVE_INTERNAL=32768

# --- Native Wi-Fi on P4 host (mutually exclusive with esp_wifi_remote) ---
# CONFIG_ESP_HOST_WIFI_ENABLED is not set

# --- ESP-Hosted: Espressif "ESP32-P4 Function EV" SDIO preset (matches Waveshare routing per README) ---
CONFIG_ESP_HOSTED_ENABLED=y
CONFIG_ESP_HOSTED_CP_TARGET_ESP32C6=y
CONFIG_ESP_HOSTED_PRIV_ENABLE_WIFI_OPTIONS=y
CONFIG_ESP_HOSTED_IDF_SLAVE_TARGET="esp32c6"
CONFIG_ESP_HOSTED_P4_DEV_BOARD_FUNC_BOARD=y
CONFIG_ESP_HOSTED_SDIO_HOST_INTERFACE=y
CONFIG_ESP_HOSTED_SDIO_RESET_ACTIVE_HIGH=y
CONFIG_ESP_HOSTED_SDIO_OPTIMIZATION_RX_STREAMING_MODE=y
CONFIG_ESP_HOSTED_SDIO_SLOT_1=y
CONFIG_ESP_HOSTED_SDIO_4_BIT_BUS=y
CONFIG_ESP_HOSTED_SDIO_BUS_WIDTH=4
CONFIG_ESP_HOSTED_SDIO_CLOCK_FREQ_KHZ=40000
CONFIG_ESP_HOSTED_SDIO_TX_Q_SIZE=20
CONFIG_ESP_HOSTED_SDIO_RX_Q_SIZE=20
CONFIG_ESP_HOSTED_SDIO_RESET_DELAY_MS=1500
CONFIG_ESP_HOSTED_SLAVE_RESET_ON_EVERY_HOST_BOOTUP=y
CONFIG_ESP_HOSTED_GPIO_SLAVE_RESET_SLAVE=54
CONFIG_ESP_HOSTED_TRANSPORT_RESTART_ON_FAILURE=y
CONFIG_ESP_HOSTED_MEM_MONITOR=y
CONFIG_ESP_HOSTED_ENABLE_ITWT=y
CONFIG_ESP_HOSTED_USE_MEMPOOL=y
CONFIG_ESP_HOSTED_MAX_SIMULTANEOUS_SYNC_RPC_REQUESTS=5
CONFIG_ESP_HOSTED_MAX_SIMULTANEOUS_ASYNC_RPC_REQUESTS=5
CONFIG_ESP_HOSTED_HOST_TO_ESP_WIFI_DATA_THROTTLE=y
CONFIG_ESP_HOSTED_PRIV_WIFI_TX_SDIO_HIGH_THRESHOLD=80
CONFIG_ESP_HOSTED_TO_WIFI_DATA_THROTTLE_HIGH_THRESHOLD=80
CONFIG_ESP_HOSTED_TO_WIFI_DATA_THROTTLE_LOW_THRESHOLD=60
CONFIG_ESP_HOSTED_ENABLE_PEER_DATA_TRANSFER=y
CONFIG_ESP_HOSTED_MAX_CUSTOM_MSG_HANDLERS=3

CONFIG_ESP_WIFI_REMOTE_ENABLED=y
CONFIG_ESP_WIFI_REMOTE_LIBRARY_HOSTED=y

# --- BSP: 720x720 4" (not 800x800 3.4") ---
# Two DPI framebuffers + avoid-tear + full refresh: LVGL renders into panel VRAM (esp_lvgl_port); partial+single-FB can stay black on P4 DSI.
CONFIG_BSP_LCD_DPI_BUFFER_NUMS=2
CONFIG_BSP_DISPLAY_LVGL_AVOID_TEAR=y
CONFIG_BSP_DISPLAY_LVGL_FULL_REFRESH=y
# CONFIG_BSP_DISPLAY_LVGL_DIRECT_MODE is not set
CONFIG_BSP_LCD_COLOR_FORMAT_RGB888=y
CONFIG_BSP_LCD_TYPE_720_720_4_INCH=y

# --- Stacks: Lottie runs after lv_async_call; keep headroom on main if defaults merge here ---
CONFIG_ESP_MAIN_TASK_STACK_SIZE=32768
# PSRAM stacks: on IDF 5.4+ this implies external stack allocation where supported.
CONFIG_FREERTOS_TASK_CREATE_ALLOW_EXT_MEM=y

# --- TLS: LAN / self-signed devices (e.g. Reolink); treat OTA URLs as trusted inputs ---
CONFIG_ESP_TLS_INSECURE=y
CONFIG_ESP_TLS_SKIP_SERVER_CERT_VERIFY=y

# --- LVGL: ThorVG + Lottie + gestures (see README) ---
CONFIG_LV_CONF_SKIP=y
CONFIG_LV_COLOR_DEPTH_24=y
CONFIG_LV_DEF_REFR_PERIOD=33
CONFIG_LV_USE_DRAW_SW=y
CONFIG_LV_USE_VECTOR_GRAPHIC=y
CONFIG_LV_USE_THORVG=y
CONFIG_LV_USE_THORVG_INTERNAL=y
CONFIG_LV_USE_LOTTIE=y
CONFIG_LV_USE_FLOAT=y
CONFIG_LV_USE_MATRIX=y
CONFIG_LV_USE_GESTURE_RECOGNITION=y
CONFIG_LV_FONT_MONTSERRAT_24=y

CONFIG_IDF_EXPERIMENTAL_FEATURES=y

# LCD debug: set both to 0 for normal boot after display works.
CONFIG_SCREEN_TEST_LCD_DSI_PATTERN_BOOT_MS=0
CONFIG_SCREEN_TEST_LCD_SOLID_RED_BOOT_MS=0
```
